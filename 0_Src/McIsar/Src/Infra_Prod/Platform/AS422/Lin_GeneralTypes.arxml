AUTOSAR XML (schema 4-2-2)
# Copyright (C) Infineon Technologies (2020)
# All rights reserved.
package /AUTOSAR_Lin_GeneralTypes/ImplementationDataTypes
  6 x impl type, all with type-emitter=BSW:
    Lin_FramePidType: implementation-data-type=uint8
    Lin_FrameDlType: implementation-data-type=uint8
    Lin_FrameCsModelType: compu {0=LIN_ENHANCED_CS, 1=LIN_CLASSIC_CS}, implementation-data-type=uint32, additional-native-type-qualifier=enum
    Lin_FrameResponseType: compu {0=LIN_MASTER_RESPONSE, 1=LIN_SLAVE_RESPONSE, 2=LIN_SLAVE_TO_SLAVE}, implementation-data-type=uint32, additional-native-type-qualifier=enum
    Lin_StatusType: compu {0=LIN_NOT_OK, 1=LIN_TX_OK, 2=LIN_TX_BUSY, 3=LIN_TX_HEADER_ERROR, 4=LIN_RX_OK, 5=LIN_RX_BUSY, 6=LIN_RX_ERROR, 7=LIN_RX_NO_RESPONSE, 8=LIN_OPERATIONAL, 9=LIN_CH_SLEEP}, implementation-data-type=uint32, additional-native-type-qualifier=enum
    Lin_PduType: category=STRUCTURE
      5 x element:
        Pid: implementation-data-type=Lin_FramePidType
        Cs: implementation-data-type=Lin_FrameCsModelType
        Drc: implementation-data-type=Lin_FrameResponseType
        Dl: implementation-data-type=Lin_FrameDlType
        SduPtr: category=DATA_REFERENCE, sw-pointer-target-props={target-category=TYPE_REFERENCE, implementation-data-type=uint8}
