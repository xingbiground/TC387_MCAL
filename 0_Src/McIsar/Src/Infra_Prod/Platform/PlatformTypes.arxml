AUTOSAR XML (schema 4-2-2)
# Copyright (C) Infineon Technologies (2018)
# All rights reserved.
standard types defined: boolean, sint8_least, sint16_least, sint32_least, uint8_least, uint16_least, uint32_least, float32, float64, sint8, sint16, sint32, sint64, uint8, uint16, uint32, uint64, Boolean, SInt8, SInt16, SInt32, SInt64, UInt8, UInt16, UInt32, UInt64, Float32, Float64, void
package /AUTOSAR_Platform/ImplementationDataTypes/DataConstrs_compu
  range boolean_constr: raw 0..1
  range sint8_constr: raw -128..127
  range sint16_constr: raw -32768..32767
  range sint32_constr: raw -2147483648..2147483647
  range sint64_constr: raw -9223372036854775807..9223372036854775807
  range uint8_constr: raw 0..255
  range uint16_constr: raw 0..65535
  range uint32_constr: raw 0..4294967295
  range uint64_constr: raw 0..18446744073709551615
  compu method Boolean_compu: 0=FALSE, 1=TRUE
